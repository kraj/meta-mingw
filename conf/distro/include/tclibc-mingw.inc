## conf/machine/mingw.conf
```bitbake
DEFAULTTUNE = "core2-64"
require conf/machine/include/tune-core2.inc

TARGET_OS = "mingw32"

TCLIBC = "mingw"

GCCTHREADS_mingw32 = "win32"

USE_NLS_mingw32 = "no"

FILES_${PN}-staticdev_append_mingw32 = " ${libdir}/*.lib"
ALLOW_EMPTY_${PN}_mingw32 = "1"

MACHINEOVERRIDES .= ":mingw32"
BASECANADIANEXTRAOS_append = " mingw32"
MODIFYTOS = "0"

export WINDRES = "${HOST_PREFIX}windres --include-dir=${STAGING_INCDIR}"
export RC = "${WINDRES}"

BB_HASHBASE_WHITELIST_append = " WINDRES RC"

# Needed to override no-static-libs.inc
DISABLE_STATIC_mingw32 = ""

LINKER_HASH_STYLE_mingw32 = ""

# hardening flags for mingw32
SECURITY_LDFLAGS_mingw32 = "-fstack-protector-strong"
SECURITY_X_LDFLAGS_mingw32 = "-fstack-protector-strong"
SECURITY_CFLAGS_mingw32 = "-fstack-protector-strong ${lcl_maybe_fortify} ${SECURITY_NOPIE_CFLAGS}"
SECURITY_CFLAGS_pn-libgcc_mingw32 = ""
GCCPIE_mingw32 = ""
GLIBCPIE_mingw32 = ""
```
